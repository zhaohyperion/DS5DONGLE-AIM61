## defconfig
```kconfig
CONFIG_FREERTOS =y
CONFIG_BLUETOOTH =y
CONFIG_RF =y
CONFIG_BTBLECONTROLLER_LIB =ble1m2s1bredr1
CONFIG_BFLB_MTD =y
CONFIG_PARTITION =y
CONFIG_FOTA =y
CONFIG_ENABLE_IMG_HASH =y
CONFIG_OTA_HEADER_USE_SDK_VERSION =y
CONFIG_OTA_VERSION_CHECK =y
CONFIG_OTA_VERSION_PREFIX ="EVENT_V"
CONFIG_MBEDTLS =y
CONFIG_MBEDTLS_ECDSA_C =y
CONFIG_MBEDTLS_ECP_C =y
CONFIG_MBEDTLS_ECP_DP_SECP256R1_ENABLED =y
CONFIG_MBEDTLS_SHA256 =y
CONFIG_LITTLEFS =y
CONFIG_CHERRYUSB =y
CONFIG_CHERRYUSB_OSAL =freertos
CONFIG_CHERRYUSB_DEVICE =y
CONFIG_CHERRYUSB_DEVICE_HID =y
CONFIG_CHERRYUSB_DEVICE_AUDIO =y
CONFIG_EM_SIZE =32
CONFIG_CONSOLE_UART_BAUDRATE =115200
```
